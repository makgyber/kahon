## zmk-r/Kconfig.defconfig
```kconfig
# Copyright (c) 2020 The ZMK Contributors
# SPDX-License-Identifier: MIT

if SHIELD_KAHON_R

config ZMK_KEYBOARD_NAME
	default "KAHON_R"


endif
```

## zmk-r/Kconfig.shield
```kconfig
# Copyright (c) 2020 The ZMK Contributors
# SPDX-License-Identifier: MIT

config SHIELD_KAHON_R
	def_bool $(shields_list_contains,kahon_r)
```

## zmk-split/Kconfig.defconfig
```kconfig
# Copyright (c) 2020 The ZMK Contributors
# SPDX-License-Identifier: MIT

if SHIELD_KAHON_LEFT

config ZMK_KEYBOARD_NAME
	default "KAHON SPLIT"

config ZMK_SPLIT_BLE_ROLE_CENTRAL
	default y

endif


if SHIELD_KAHON_RIGHT || SHIELD_KAHON_LEFT 

config ZMK_SPLIT
	default y

endif
```

## zmk-split/Kconfig.shield
```kconfig
# Copyright (c) 2020 The ZMK Contributors
# SPDX-License-Identifier: MIT

config SHIELD_KAHON_LEFT
	def_bool $(shields_list_contains,kahon_left)


config SHIELD_KAHON_RIGHT
	def_bool $(shields_list_contains,kahon_right)
```

## zmk/Kconfig.defconfig
```kconfig
# Copyright (c) 2020 The ZMK Contributors
# SPDX-License-Identifier: MIT

if SHIELD_KAHON

config ZMK_KEYBOARD_NAME
	default "KAHON"


endif
```
